#include "ahuai51.h"
/*Tis liabry without LCD is written by ChenAo for AHU-AI*/

/*** about LCD Chars and Chinese***/
char code ASC_MSK[96][16] = {
	{0x00,0x00,0x00,0x00,0x00,0x00,0x00,0x00,/*-- --*/
		0x00,0x00,0x00,0x00,0x00,0x00,0x00,0x00},
	{0x00,0x00,0x00,0x18,0x3c,0x3c,0x3c,0x18,/*-- ! --*/
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		0x00,0x00,0x1c,0x1c,0x00,0x00,0x00,0x00}
};
	
typedef struct typefnt{
		unsigned char Index[2];
		unsigned char Msk[32];
		}FNT_GBHZ;
	
FNT_GBHZ code GBHZ_Table[] = {
		"▆",
		0x00,0x00,0x7f,0xfc,0x7f,0xfc,0x7f,0xfc,
		0x7f,0xfc,0x7f,0xfc,0x7f,0xfc,0x7f,0xfc,
		0x7f,0xfc,0x7f,0xfc,0x7f,0xfc,0x7f,0xfc,
		0x7f,0xfc,0x7f,0xfc,0x00,0x00,0x00,0x00,
		"液",
		0x40,0x40,0x20,0x20,0x27,0xfe,0x09,0x20,
		0x89,0x20,0x52,0x7c,0x52,0x44,0x16,0xa8,
		0x2b,0x98,0x22,0x50,0xe2,0x20,0x22,0x30,
		0x22,0x50,0x22,0x88,0x23,0x0e,0x22,0x04,/*"ye",*/
		"晶",
		0x00,0x00,0x0f,0xf0,0x08,0x10,0x0f,0xf0,
		0x08,0x10,0x0f,0xf0,0x08,0x10,0x00,0x00,
		0x7e,0x7e,0x42,0x42,0x7e,0x7e,0x42,0x42,
		0x42,0x42,0x7e,0x7e,0x42,0x42,0x00,0x00,/*"jing",*/
		"显",
		0x00,0x00,0x1f,0xf0,0x10,0x10,0x1f,0xf0,
		0x10,0x10,0x1f,0xf0,0x04,0x40,0x04,0x40,
		0x44,0x48,0x24,0x48,0x14,0x50,0x14,0x60,
		0x04,0x40,0xff,0xfe,0x00,0x00,0x00,0x00,/*"xian",*/
		"示",
		0x00,0x00,0x1f,0xf8,0x00,0x00,0x00,0x00,
		0x00,0x00,0x7f,0xfe,0x01,0x00,0x01,0x00,
		0x11,0x20,0x11,0x10,0x21,0x08,0x41,0x0c,
		0x81,0x04,0x01,0x00,0x05,0x00,0x02,0x00,/*"shi",*/
		"测",
		0x40,0x02,0x27,0xc2,0x24,0x42,0x84,0x52,
		0x45,0x52,0x55,0x52,0x15,0x52,0x25,0x52,
		0x25,0x52,0x25,0x52,0xc5,0x52,0x41,0x02,
		0x42,0x82,0x42,0x42,0x44,0x4a,0x48,0x04,/*"ce",*/
		"试",
		0x00,0x20,0x40,0x28,0x20,0x24,0x30,0x24,
		0x27,0xfe,0x00,0x20,0xe0,0x20,0x27,0xe0,
		0x21,0x20,0x21,0x10,0x21,0x10,0x21,0x0a,
		0x29,0xca,0x36,0x06,0x20,0x02,0x00,0x00,/*"shi2",*/
		"屏",
		0x3f,0xfc,0x20,0x04,0x20,0x04,0x3f,0xfc,
		0x24,0x10,0x22,0x20,0x2f,0xfc,0x22,0x20,
		0x22,0x20,0x3f,0xfe,0x22,0x20,0x22,0x20,
		0x44,0x20,0x44,0x20,0x88,0x20,0x10,0x20,/*"ping",*/
		"幕",
		0x04,0x40,0xff,0xfe,0x04,0x40,0x1f,0xf0,
		0x10,0x10,0x1f,0xf0,0x10,0x10,0x1f,0xf0,
		0x02,0x00,0xff,0xfe,0x09,0x10,0x1f,0xe8,
		0x29,0x26,0xc9,0x24,0x09,0x60,0x01,0x00,/*"mu",*/
		"分",
		0x08,0x80,0x0c,0x80,0x08,0x40,0x10,0x20,
		0x10,0x30,0x20,0x18,0x40,0x0e,0x9f,0xe4,
		0x04,0x20,0x04,0x20,0x04,0x20,0x04,0x20,
		0x08,0x20,0x10,0xa0,0x20,0x40,0x40,0x00,/*"fen",*/
		"辨",
		0x20,0x90,0x10,0x88,0xfe,0xfe,0x00,0x84,
		0x46,0xc6,0x2a,0xa8,0xfe,0x80,0x12,0xfe,
		0x10,0x90,0x7c,0x90,0x11,0x7e,0x21,0x10,
		0x22,0x10,0x42,0x10,0x84,0x10,0x08,0x10,/*"bian",*/
		"率",
		0x02,0x00,0x01,0x00,0x7f,0xfe,0x41,0x00,
		0x22,0x28,0x17,0xd0,0x04,0x80,0x11,0x10,
		0x22,0x48,0x47,0xc4,0x01,0x20,0xfe,0xfe,
		0x01,0x00,0x01,0x00,0x01,0x00,0x01,0x00,/*"lv",*/
		"年",
		0x08,0x80,0x0f,0xfc,0x10,0x80,0x10,0x80,
		0x20,0x80,0x4f,0xf8,0x88,0x80,0x08,0x80,
		0x08,0x80,0x08,0x80,0xff,0xfe,0x00,0x80,
		0x00,0x80,0x00,0x80,0x00,0x80,0x00,0x80,/*"nian",*/
		"月",
		0x07,0xf0,0x04,0x10,0x04,0x10,0x04,0x10,
		0x07,0xf0,0x04,0x10,0x04,0x10,0x04,0x10,
		0x07,0xf0,0x04,0x10,0x08,0x10,0x08,0x10,
		0x10,0x10,0x20,0x50,0x40,0x20,0x00,0x00,/*"yue",*/
		"日",
		0x00,0x00,0x1f,0xf0,0x10,0x10,0x10,0x10,
		0x10,0x10,0x10,0x10,0x1f,0xf0,0x10,0x10,
		0x10,0x10,0x10,0x10,0x10,0x10,0x10,0x10,
		0x1f,0xf0,0x10,0x10,0x00,0x00,0x00,0x00,/*"ri",*/
	};

	
/* function area*/
void delay_100ms(uint8_t x){
	uint8_t i, j, k;
	for(i = 0; i < x; i++)
		for(j = 0; j < 200; j++)
			for(k = 0; k < 165; k++);
}


void delay_ms(uint16_t x){
	uint16_t i;
	uint8_t j;
	for(i = 0; i < x; i++) 
		for(j = 0; j < 113; j++);
}


void IO_WritePin(uint8_t IO, uint8_t Pin_Nums, uint8_t type){	
	type = type ? 0x00 : 0xff;
	
	switch(IO){
		case IO_P0:
			P0 = Pin_Nums ^ type;
			break;
		
		case IO_P1:
			P1 = Pin_Nums ^ type;
			break;
		
		case IO_P2:
			P2 = Pin_Nums ^ type;
	    break;
		
		case IO_P3:
			P3 = Pin_Nums ^ type;
	    break;
		
		default: 
			break;
	}
}


void IO_TooglePin(uint8_t IO, uint8_t Pin_Nums){
	switch(IO){
		case IO_P0:
			P0 = (P0 & (~Pin_Nums)) | (P0 ^ Pin_Nums);
			break;
		
		case IO_P1:
			
		 	P1 = (P1 & (~Pin_Nums)) | (P1 ^ Pin_Nums);
			break;
		
		case IO_P2:
			P2 = (P2 & (~Pin_Nums)) | (P2 ^ Pin_Nums);
	    break;
		
		case IO_P3:
			P3 = (P3 & (~Pin_Nums)) | (P3 ^ Pin_Nums);
	    break;
		
		default: 
			break;
	}
}


uint8_t IO_ReadPin(uint8_t IO, uint8_t Pin_Nums){
		switch(IO){
		case IO_P0:
			return P0 & Pin_Nums ? PIN_SET : PIN_RESET;
			break;
		
		case IO_P1:
		 	return P1 & Pin_Nums ? PIN_SET : PIN_RESET;
			break;
		
		case IO_P2:
			return P2 & Pin_Nums ? PIN_SET : PIN_RESET;
	    break;
		
		case IO_P3:
			return P3 & Pin_Nums ? PIN_SET : PIN_RESET;
	    break;
		
		default: 
			return PIN_RESET;
			break;
	}

}


uint8_t IO_ReadAllPins(uint8_t IO) {
	switch(IO){
		case IO_P0:
			return P0;
			break;
		
		case IO_P1:
		 	return P1;
			break;
		
		case IO_P2:
			return P2;
	    break;
		
		case IO_P3:
			return P3;
	    break;
		
		default: 
			return PIN_RESET;
			break;
	}
}


void smg_postive_static(uint8_t IO, uint8_t element) {
	uint8_t element_index = 0;
	uint8_t smg_libary_static[19] = {0xc0, 0xf9, 0xa4, 0xb0, 0x99, 0x92, 0x82, 0xf8, 0x80, 0x90, 0x88, 0x83, 0xc6, 0xa1, 0x86, 0x8e, 0xbf, 0x7f, 0xff};

	if (element > 0x2f) { // numbers & chars
		element_index = element - 0x30;
		if (element > 0x40) {  // chars
			element_index = element_index - 7;
		}
		goto smg_postive1_static_out;
	}
	
	switch (element) { // special
		case '-':
			element_index = 16;
		 break;
		
		case '.':
			element_index = 17;
		 break;
		
		default:
			element_index = 18;
	}
	
smg_postive1_static_out:
	switch (IO) {
		case IO_P0:
			P0 = smg_libary_static[element_index];
			break;
		
		case IO_P1:
			P1 = smg_libary_static[element_index];
			break;
		
		case IO_P2:
			P2 = smg_libary_static[element_index];
			break;
		
		case IO_P3:
			P3 = smg_libary_static[element_index];
			break;
		
		default:
			return;
	}
}

void smg_MPX2_postive_all(uint8_t IO1, uint8_t pin1, uint8_t IO2, uint8_t pin2, uint8_t IO3, uint8_t element1, uint8_t element2) {
	/***   ATTENTION:ABANDON & NOT RECOMMEND   ***/
	
	smg_MPX2_postive_left(IO1, pin1, IO3, element1);
	delay_ms(7);
	
	smg_MPX2_postive_right(IO2, pin2, IO3, element2);
	delay_ms(7);
}

void smg_MPX2_postive_left(uint8_t IO1, uint8_t pin, uint8_t IO2, uint8_t element) {
	IO_WritePin(IO1, pin, PIN_SET);
	smg_postive_static(IO2, element);	
}
	

void smg_MPX2_postive_right(uint8_t IO1, uint8_t pin, uint8_t IO2, uint8_t element) {
	IO_WritePin(IO1, pin, PIN_SET);
	smg_postive_static(IO2, element);
}


void smg_MPX2_postive_display(uint8_t IO1, uint8_t IO2, uint8_t element_left, uint8_t element_right) {
	switch(FLAG_MPX2_MODE) {
		case 1:
			smg_MPX2_postive_left(IO1, PIN_0, IO2, element_left);
			FLAG_MPX2_MODE = 2;
			break;
	
		case 2:
			smg_MPX2_postive_right(IO1, PIN_1, IO2, element_right);
			FLAG_MPX2_MODE = 1;
			break;
		
		default:
			IO_WritePin(IO1, PIN_ALL, PIN_RESET);
			break;
	}
}


void smg_MPX6_postive_single(uint8_t IO1, uint8_t IO2, uint8_t pin, uint8_t element, uint8_t switch_single) {
	
	if (!switch_single) {
		IO_WritePin(IO1, PIN_ALL, PIN_RESET);
		return;
	}
	IO_WritePin(IO1, pin, PIN_SET);
	smg_postive_static(IO2, element);
}


void smg_MPX6_postive_display(uint8_t IO1, uint8_t IO2, uint8_t *switchs, uint8_t element_1, uint8_t element_2, uint8_t element_3, uint8_t element_4, uint8_t element_5, uint8_t element_6) {
	switch(FLAG_MPX6_MODE) {
		case 1:
			smg_MPX6_postive_single(IO1, IO2, PIN_0, element_1, *(switchs));
			FLAG_MPX6_MODE = 2;
			break;
	
		case 2:
			smg_MPX6_postive_single(IO1, IO2, PIN_1, element_2, *(switchs + 1));
			FLAG_MPX6_MODE = 3;
			break;
		
		case 3:
			smg_MPX6_postive_single(IO1, IO2, PIN_2, element_3, *(switchs + 2));
			FLAG_MPX6_MODE = 4;
			break;
		
		case 4:
			smg_MPX6_postive_single(IO1, IO2, PIN_3, element_4, *(switchs + 3));
			FLAG_MPX6_MODE = 5;
			break;
		
		case 5:
			smg_MPX6_postive_single(IO1, IO2, PIN_4, element_5, *(switchs + 4));
			FLAG_MPX6_MODE = 6;
			break;
		
		case 6:
			smg_MPX6_postive_single(IO1, IO2, PIN_5, element_6, *(switchs + 5));
			FLAG_MPX6_MODE = 1;
			break;
		
		
		default:
			IO_WritePin(IO1, PIN_ALL, PIN_RESET);
			break;
	}
}


uint8_t get_key_single_PullUp(uint8_t IO) {
	uint8_t key_code;
	IO_WritePin(IO, PIN_ALL, PIN_SET);
	key_code = IO_ReadAllPins(IO);
	if (key_code != KEY_NONE){
		delay_ms(20);
		while(IO_ReadAllPins(IO) != KEY_NONE);
		IO_WritePin(IO, PIN_ALL, PIN_SET);
	}
	return ~key_code;
}


void LCD_Busy()
{
		unsigned int dat;
		do{
			LCD_DataPort=0xff;
			LCD_CD=1;
			LCD_RD=0;
			dat=LCD_DataPort;
			LCD_RD=1;
			dat=0x03&dat;
		}while(dat!=0x03);
	}
	
void LCD_Data(dat)
{
	LCD_Busy();
	LCD_CD=0;
  LCD_DataPort=dat;
	LCD_WR=0;
	LCD_WR=1;
}

void LCD_Com1(command)
{
	LCD_Busy();
	LCD_CD=1;
	LCD_DataPort=command;
	LCD_WR=0;
	LCD_WR=1;
}

void LCD_Com2(dat,command)
{
	LCD_Data(dat);
	LCD_Com1(command);
}

void LCD_Com3(data1,data2,command)
{
	LCD_Data(data1);
	LCD_Data(data2);
	LCD_Com1(command);
}

void LCD_Clear()
{
	long i;
	LCD_Com3(0x00,0x00,LC_ADD_POS);
	LCD_Com1(LC_AUT_WR);
	for(i=0;i<20480;i++) LCD_Data(0x00);
	LCD_Com1(LC_AUT_OVR);
}

void LCD_Init()
{
	LCD_CE=0;
	LCD_CD=1;
	LCD_WR=1;
	LCD_RD=1;
	
	LCD_Com1(LC_DIS_SW);
	LCD_Com3(0x00,0x00,LC_GRH_STP);
	LCD_Com3(Gus_LCM_YMAX,0x00,LC_GRH_WID);
	LCD_Com1(LC_MOD_OR);
	LCD_Com1(LC_DIS_SW|0x08);
	LCD_Clear();
}

void LCD_HZ(unsigned int x,unsigned int y,unsigned int n)
{
	unsigned int i,StartAddr;
	FNT_GBHZ *ptGb16=(FNT_GBHZ*)GBHZ_Table;
	
	StartAddr = x*160+y;
	for(i=0;i<16;i++)
	{
		LCD_Com3(StartAddr,((StartAddr)/256),LC_ADD_POS);
		LCD_Com2(ptGb16[n].Msk[i*2],LC_INC_WR);
		LCD_Com2(ptGb16[n].Msk[i*2+1],LC_NOC_WR);
		StartAddr=StartAddr + 20;
	}
}

void LCD_CHAR(unsigned int x,unsigned int y,unsigned int n)
{
	unsigned int i,StartAddr;
	StartAddr = x*160+y;
	for(i=0;i<16;i++)
	{
		LCD_Com3(StartAddr,((StartAddr)/256),LC_ADD_POS);
		LCD_Com2(ASC_MSK[n][i],LC_INC_WR);
		StartAddr=StartAddr + 20;
	}
}
uint findHzIndex(uchar *hz)
{
	uint i=0;
	FNT_GBHZ *ptGb16 = (FNT_GBHZ*)GBHZ_Table;
	while(ptGb16[i].Index[0]>0x80)
	{
		if((*hz==ptGb16[i].Index[0])&&(*(hz+1)==ptGb16[i].Index[1]))
		{
			return i;
		}
		i++;
		if(i>(sizeof(GBHZ_Table)/sizeof(FNT_GBHZ)-1))
		{
			break;
		}
	}
	return 0;
}

void writeString(unsigned char *pcStr,unsigned short x0,unsigned int y0)
{
	uchar i,uLen;
		unsigned int usIndex;
		unsigned int usWidth = 0;
		FNT_GBHZ *ptGb16 = 0;
	ptGb16 = (FNT_GBHZ*)GBHZ_Table;
	i=0;
	uLen = strlen(pcStr);
		while(1)
		{
			if(i>=uLen)
			{
				break;
			}
			if(*pcStr>0x80)
			{
				if(x0+2>Gus_LCM_XMAX)
				{
					x0=0;
					y0=0;
				}
				if(y0+2>Gus_LCM_YMAX)
				{
					x0=x0+2;
					y0=0;
				}
				usIndex = findHzIndex(pcStr);
				LCD_HZ(x0,y0,usIndex);
				y0=y0+2;
				pcStr+=2;
				i+=2;
			}
			else
			{
				if(*pcStr == '\r')
				{
					x0 = x0 + 2;
					if(x0+2>=Gus_LCM_XMAX)
					{
						x0=0;
					}
					pcStr++;i++;
					continue;
				}
				else if(*pcStr == '\n')
				{
					y0 = 0;
					pcStr++;i++;
					continue;
				}
				else
				{
					if(x0+1>Gus_LCM_XMAX)
					{
						x0=0;
						y0=0;
					}
					if(y0+1>Gus_LCM_YMAX)
					{
						x0=x0+2;
						y0=0;
					}
					usIndex = *pcStr - 0x20;
					LCD_CHAR(x0,y0,usIndex);
					y0=y0+1;
					pcStr ++;
					i++;
				}
		}
	}
}
